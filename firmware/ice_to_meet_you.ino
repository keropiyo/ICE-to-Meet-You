#include <Arduino.h>

HardwareSerial MidiSerial(1);

const int MIDI_TX_PIN = 4;   // Unit Synth RX
const int MOTOR_PIN   = 5;   // 1kΩ -> 2SC1815 base
const byte MIDI_CHANNEL = 0;
const byte MUSIC_BOX_PROGRAM = 10;
const byte REVERB_LEVEL = 120;
const byte VOLUME_LEVEL = 120;  // MIDI channel volume (0-127)

// Motor PWM settings
const int MOTOR_PWM_FREQ = 5000;
const int MOTOR_PWM_RES  = 8;      // 0-255
const int MOTOR_SPEED    = 200;    // 通常回転：小さいほどゆっくり
const int MOTOR_BOOST    = 220;    // 始動時だけ少し強く
const int BOOST_TIME_MS  = 250;    // 始動ブースト時間

struct MidiEvent {
  uint16_t waitMs;
  uint8_t note;
  uint8_t velocity;
  uint8_t noteOn;
};

void send3(byte status, byte data1, byte data2) {
  MidiSerial.write(status);
  MidiSerial.write(data1);
  MidiSerial.write(data2);
}

void programChange(byte channel, byte program) {
  MidiSerial.write(0xC0 | (channel & 0x0F));
  MidiSerial.write(program);
}

void controlChange(byte channel, byte control, byte value) {
  send3(0xB0 | (channel & 0x0F), control, value);
}

void noteOn(byte note, byte velocity) {
  send3(0x90 | MIDI_CHANNEL, note, velocity);
}

void noteOff(byte note) {
  send3(0x80 | MIDI_CHANNEL, note, 0);
}

const MidiEvent song[] = {
  {162, 67, 81, 1},
  {0, 83, 62, 1},
  {303, 83, 0, 0},
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  {0, 79, 0, 0},
};

const size_t SONG_EVENT_COUNT = sizeof(song) / sizeof(song[0]);

void allNotesOff() {
  controlChange(MIDI_CHANNEL, 123, 0);
}

// 曲の時間に合わせてペンギンを踊らせる
// OFF→ONになった瞬間だけ強めに250ms、その後ゆっくり回す
void updateMotor(uint32_t t) {
  static bool previousOn = false;
  static uint32_t motorStartedAt = 0;

  bool on =
      (t >=  4000 && t < 14000) ||  // 出会って踊り始める
      (t >= 16000 && t < 28000) ||  // もう一度くるくる
      (t >= 31000 && t < 43000) ||  // 中盤
      (t >= 46000 && t < 57500);    // ラストダンス

  if (on && !previousOn) {
    motorStartedAt = t;
  }

  if (!on) {
    ledcWrite(MOTOR_PIN, 0);
  } else if (t - motorStartedAt < BOOST_TIME_MS) {
    ledcWrite(MOTOR_PIN, MOTOR_BOOST);
  } else {
    ledcWrite(MOTOR_PIN, MOTOR_SPEED);
  }

  previousOn = on;
}

void playSong() {
  allNotesOff();

  uint32_t songTime = 0;
  ledcWrite(MOTOR_PIN, 0);

  for (size_t i = 0; i < SONG_EVENT_COUNT; i++) {
    uint16_t waitMs = song[i].waitMs;

    // 長めの待ち時間でもモーターのタイミングを逃さないよう、
    // 10msずつ進めながら状態を更新する
    while (waitMs > 0) {
      uint16_t step = (waitMs > 10) ? 10 : waitMs;
      delay(step);
      songTime += step;
      waitMs -= step;
      updateMotor(songTime);
    }

    if (song[i].noteOn) {
      noteOn(song[i].note, song[i].velocity);
    } else {
      noteOff(song[i].note);
    }
  }

  ledcWrite(MOTOR_PIN, 0);
  allNotesOff();
}

void setup() {
  // G5をモーター用PWM出力にする
  ledcAttach(MOTOR_PIN, MOTOR_PWM_FREQ, MOTOR_PWM_RES);
  ledcWrite(MOTOR_PIN, 0);

  MidiSerial.begin(31250, SERIAL_8N1, -1, MIDI_TX_PIN);
  delay(700);

  programChange(MIDI_CHANNEL, MUSIC_BOX_PROGRAM);
  controlChange(MIDI_CHANNEL, 7, VOLUME_LEVEL);
  controlChange(MIDI_CHANNEL, 91, REVERB_LEVEL);
  delay(200);

  playSong();
}

void loop() {
}
